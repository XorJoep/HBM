/*******************************************************************/
/*                                                                 */
/* This file is automatically generated by linker script generator.*/
/*                                                                 */
/* Version: 2019.2.1                                               */
/*                                                                 */
/* Copyright (c) 2010-2019 Xilinx, Inc.  All rights reserved.      */
/*                                                                 */
/* Description : MicroBlaze Linker Script                           */
/*                                                                 */
/*******************************************************************/

_STACK_SIZE = DEFINED(_STACK_SIZE) ? _STACK_SIZE : 0x1000;
_HEAP_SIZE = DEFINED(_HEAP_SIZE) ? _HEAP_SIZE : 0x1000;

/* Define Memories in the system */

MEMORY
{
   microblaze_0_local_memory_ilmb_bram_if_cntlr_Mem_hbm_0_HBM_MEM00 : ORIGIN = 0x50, LENGTH = 0x1FFB0
   hbm_0_HBM_MEM01 : ORIGIN = 0x10000000, LENGTH = 0x10000000
   hbm_0_HBM_MEM02 : ORIGIN = 0x20000000, LENGTH = 0x10000000
   hbm_0_HBM_MEM03 : ORIGIN = 0x30000000, LENGTH = 0x10000000
   hbm_0_HBM_MEM04 : ORIGIN = 0x42000000, LENGTH = 0x2000000
   microblaze_0_local_memory_dlmb_bram_if_cntlr_Mem : ORIGIN = 0x4A000000, LENGTH = 0x20000
   hbm_0_HBM_MEM05 : ORIGIN = 0x50000000, LENGTH = 0x10000000
   hbm_0_HBM_MEM06 : ORIGIN = 0x60000000, LENGTH = 0x10000000
   hbm_0_HBM_MEM07 : ORIGIN = 0x70000000, LENGTH = 0x10000000
   hbm_0_HBM_MEM08 : ORIGIN = 0x80000000, LENGTH = 0x10000000
   hbm_0_HBM_MEM09 : ORIGIN = 0x90000000, LENGTH = 0x10000000
   hbm_0_HBM_MEM10 : ORIGIN = 0xA0000000, LENGTH = 0x10000000
   hbm_0_HBM_MEM11 : ORIGIN = 0xB0000000, LENGTH = 0x10000000
   hbm_0_HBM_MEM12 : ORIGIN = 0xC0000000, LENGTH = 0x10000000
   hbm_0_HBM_MEM13 : ORIGIN = 0xD0000000, LENGTH = 0x10000000
   hbm_0_HBM_MEM14 : ORIGIN = 0xE0000000, LENGTH = 0x10000000
   hbm_0_HBM_MEM15 : ORIGIN = 0xF0000000, LENGTH = 0x10000000
}

/* Specify the default entry point to the program */

ENTRY(_start)

/* Define the sections, and where they are mapped in memory */

SECTIONS
{
.vectors.reset 0x0 : {
   KEEP (*(.vectors.reset))
} 

.vectors.sw_exception 0x8 : {
   KEEP (*(.vectors.sw_exception))
} 

.vectors.interrupt 0x10 : {
   KEEP (*(.vectors.interrupt))
} 

.vectors.hw_exception 0x20 : {
   KEEP (*(.vectors.hw_exception))
} 

.text : {
   *(.text)
   *(.text.*)
   *(.gnu.linkonce.t.*)
} > microblaze_0_local_memory_ilmb_bram_if_cntlr_Mem_hbm_0_HBM_MEM00

.init : {
   KEEP (*(.init))
} > microblaze_0_local_memory_ilmb_bram_if_cntlr_Mem_hbm_0_HBM_MEM00

.fini : {
   KEEP (*(.fini))
} > microblaze_0_local_memory_ilmb_bram_if_cntlr_Mem_hbm_0_HBM_MEM00

.ctors : {
   __CTOR_LIST__ = .;
   ___CTORS_LIST___ = .;
   KEEP (*crtbegin.o(.ctors))
   KEEP (*(EXCLUDE_FILE(*crtend.o) .ctors))
   KEEP (*(SORT(.ctors.*)))
   KEEP (*(.ctors))
   __CTOR_END__ = .;
   ___CTORS_END___ = .;
} > microblaze_0_local_memory_ilmb_bram_if_cntlr_Mem_hbm_0_HBM_MEM00

.dtors : {
   __DTOR_LIST__ = .;
   ___DTORS_LIST___ = .;
   KEEP (*crtbegin.o(.dtors))
   KEEP (*(EXCLUDE_FILE(*crtend.o) .dtors))
   KEEP (*(SORT(.dtors.*)))
   KEEP (*(.dtors))
   PROVIDE(__DTOR_END__ = .);
   PROVIDE(___DTORS_END___ = .);
} > microblaze_0_local_memory_ilmb_bram_if_cntlr_Mem_hbm_0_HBM_MEM00

.rodata : {
   __rodata_start = .;
   *(.rodata)
   *(.rodata.*)
   *(.gnu.linkonce.r.*)
   __rodata_end = .;
} > microblaze_0_local_memory_ilmb_bram_if_cntlr_Mem_hbm_0_HBM_MEM00

.sdata2 : {
   . = ALIGN(8);
   __sdata2_start = .;
   *(.sdata2)
   *(.sdata2.*)
   *(.gnu.linkonce.s2.*)
   . = ALIGN(8);
   __sdata2_end = .;
} > microblaze_0_local_memory_ilmb_bram_if_cntlr_Mem_hbm_0_HBM_MEM00

.sbss2 : {
   __sbss2_start = .;
   *(.sbss2)
   *(.sbss2.*)
   *(.gnu.linkonce.sb2.*)
   __sbss2_end = .;
} > microblaze_0_local_memory_ilmb_bram_if_cntlr_Mem_hbm_0_HBM_MEM00

.data : {
   . = ALIGN(4);
   __data_start = .;
   *(.data)
   *(.data.*)
   *(.gnu.linkonce.d.*)
   __data_end = .;
} > microblaze_0_local_memory_ilmb_bram_if_cntlr_Mem_hbm_0_HBM_MEM00

.got : {
   *(.got)
} > microblaze_0_local_memory_ilmb_bram_if_cntlr_Mem_hbm_0_HBM_MEM00

.got1 : {
   *(.got1)
} > microblaze_0_local_memory_ilmb_bram_if_cntlr_Mem_hbm_0_HBM_MEM00

.got2 : {
   *(.got2)
} > microblaze_0_local_memory_ilmb_bram_if_cntlr_Mem_hbm_0_HBM_MEM00

.eh_frame : {
   *(.eh_frame)
} > microblaze_0_local_memory_ilmb_bram_if_cntlr_Mem_hbm_0_HBM_MEM00

.jcr : {
   *(.jcr)
} > microblaze_0_local_memory_ilmb_bram_if_cntlr_Mem_hbm_0_HBM_MEM00

.gcc_except_table : {
   *(.gcc_except_table)
} > microblaze_0_local_memory_ilmb_bram_if_cntlr_Mem_hbm_0_HBM_MEM00

.sdata : {
   . = ALIGN(8);
   __sdata_start = .;
   *(.sdata)
   *(.sdata.*)
   *(.gnu.linkonce.s.*)
   __sdata_end = .;
} > microblaze_0_local_memory_ilmb_bram_if_cntlr_Mem_hbm_0_HBM_MEM00

.sbss (NOLOAD) : {
   . = ALIGN(4);
   __sbss_start = .;
   *(.sbss)
   *(.sbss.*)
   *(.gnu.linkonce.sb.*)
   . = ALIGN(8);
   __sbss_end = .;
} > microblaze_0_local_memory_ilmb_bram_if_cntlr_Mem_hbm_0_HBM_MEM00

.tdata : {
   __tdata_start = .;
   *(.tdata)
   *(.tdata.*)
   *(.gnu.linkonce.td.*)
   __tdata_end = .;
} > microblaze_0_local_memory_ilmb_bram_if_cntlr_Mem_hbm_0_HBM_MEM00

.tbss : {
   __tbss_start = .;
   *(.tbss)
   *(.tbss.*)
   *(.gnu.linkonce.tb.*)
   __tbss_end = .;
} > microblaze_0_local_memory_ilmb_bram_if_cntlr_Mem_hbm_0_HBM_MEM00

.bss (NOLOAD) : {
   . = ALIGN(4);
   __bss_start = .;
   *(.bss)
   *(.bss.*)
   *(.gnu.linkonce.b.*)
   *(COMMON)
   . = ALIGN(4);
   __bss_end = .;
} > microblaze_0_local_memory_ilmb_bram_if_cntlr_Mem_hbm_0_HBM_MEM00

_SDA_BASE_ = __sdata_start + ((__sbss_end - __sdata_start) / 2 );

_SDA2_BASE_ = __sdata2_start + ((__sbss2_end - __sdata2_start) / 2 );

/* Generate Stack and Heap definitions */

.heap (NOLOAD) : {
   . = ALIGN(8);
   _heap = .;
   _heap_start = .;
   . += _HEAP_SIZE;
   _heap_end = .;
} > microblaze_0_local_memory_ilmb_bram_if_cntlr_Mem_hbm_0_HBM_MEM00

.stack (NOLOAD) : {
   _stack_end = .;
   . += _STACK_SIZE;
   . = ALIGN(8);
   _stack = .;
   __stack = _stack;
} > microblaze_0_local_memory_ilmb_bram_if_cntlr_Mem_hbm_0_HBM_MEM00

_end = .;
}

